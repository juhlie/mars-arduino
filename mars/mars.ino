#include<Arduino.h>
#include<U8g2lib.h>

#ifdef U8X8_HAVE_HW_SPI
#include<SPI.h>
#endif
#ifdef U8X8_HAVE_HW_I2C
#include<Wire.h>
#endif

U8G2_SSD1306_128X64_NONAME_F_HW_I2C u8g2(U8G2_R2, /* clock=*/ SCL, /* data=*/ SDA, /* reset=*/ U8X8_PIN_NONE);


/**
   Pin locations
*/

#define LED 4
#define BUZZER 5
#define BUTTON 6

/**
   State variables
*/

char ROVER_X = 8; // perseverance initial x-value
char ROVER_Y = -55; // perseverance initial y-value


/**
   Contents of .xbm files (image data)
   Image credits to:
      - https://solarsystem.nasa.gov/news/1573/color-your-universe/
      - https://astrobiology.nasa.gov/resources/coloring/?fbclid=IwAR1B2zrFZ3jS9w592Rm6fQculptPDsIihxEWYlhIzWM2VOI0N2atYrHKKZQ
   Big thanks to sandhansblog https://sandhansblog.wordpress.com/2017/04/16/interfacing-displaying-a-custom-graphic-on-an-0-96-i2c-oled/
*/

#define big_mars_width 64
#define big_mars_height 64
static const unsigned char big_mars_bits[] PROGMEM = {
  0x00, 0x00, 0x00, 0xe0, 0x07, 0x00, 0x00, 0x00, 0x00, 0x00, 0x00, 0xff,
  0xff, 0x01, 0x00, 0x00, 0x00, 0x00, 0xe0, 0xff, 0xff, 0x0f, 0x00, 0x00,
  0x00, 0x00, 0xfc, 0x01, 0x80, 0x3f, 0x00, 0x00, 0x00, 0x00, 0x3f, 0x00,
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  0x00, 0x00, 0x00, 0xe0, 0x07, 0x00, 0x00, 0x00
};

#define small_mars_width 64
#define small_mars_height 64
static const unsigned char small_mars_bits[] PROGMEM = {
  0x00, 0x00, 0x00, 0x00, 0x00, 0x00, 0x00, 0x00, 0x00, 0x00, 0x00, 0xe0,
  0x07, 0x00, 0x00, 0x00, 0x00, 0x00, 0x00, 0xfe, 0xdf, 0x00, 0x00, 0x00,
  0x00, 0x00, 0xc0, 0x53, 0xd5, 0x07, 0x00, 0x00, 0x00, 0x00, 0x78, 0x00,
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  0x00, 0x00, 0x00, 0x00, 0x00, 0x00, 0x00, 0x00
};

#define perseverance_width 128
#define perseverance_height 64
static const unsigned char perseverance_bits[] PROGMEM = {
  0x00, 0x00, 0x00, 0x00, 0x00, 0x00, 0x00, 0x00, 0x00, 0x00, 0x00, 0x00,
  0x00, 0x00, 0x00, 0x00, 0x00, 0x00, 0x00, 0x00, 0x00, 0x00, 0x00, 0x00,
  0x00, 0x00, 0x00, 0x00, 0x00, 0x00, 0x00, 0x00, 0x00, 0x00, 0x00, 0x00,
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  0x00, 0x00, 0x00, 0x00
};

#define mars_landscape_2_width 128
#define mars_landscape_2_height 64
static const unsigned char mars_landscape_2_bits[] PROGMEM = {
   0x00, 0x00, 0x00, 0x00, 0x00, 0x00, 0x00, 0x00, 0x00, 0x00, 0x00, 0x00,
   0x00, 0x00, 0x00, 0x00, 0x00, 0x00, 0x00, 0x00, 0x00, 0x00, 0x00, 0x00,
   0x00, 0x00, 0x00, 0x00, 0x00, 0x00, 0x00, 0x00, 0x00, 0x00, 0x00, 0x00,
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   0x89, 0xc0, 0x11, 0x02 };


void drawLongText(const char* line1 = "", const char* line2 = "", const char* line3 = "", int ms = 4000) {
  // show up to three lines of text on the screen
  u8g2.clearBuffer();
  u8g2.drawStr(0, 15, line1);
  u8g2.drawStr(0, 35, line2);
  u8g2.drawStr(0, 55, line3);
  u8g2.sendBuffer();
  delay(ms); // show for 4 sec by default
  u8g2.clearDisplay();
}

void drawShortText(const char* text = "", uint8_t x = 55, uint16_t ms = 2000) {
  // show one line of text on the screen
  u8g2.clearBuffer();
  u8g2.drawStr(x, 35, text);
  u8g2.sendBuffer();
  delay(ms); // show for 2 sec by default
  u8g2.clearDisplay();
}

void playMarsAnimation() {

  for (uint8_t i = 0; i < 3; i++) {

    // draw small mars
    u8g2.clearBuffer();
    u8g2.drawXBMP(30, 0, small_mars_width, small_mars_height, small_mars_bits);
    u8g2.sendBuffer();
    delay(50);

    // draw big mars
    u8g2.clearBuffer();
    u8g2.drawXBMP(30, 0, big_mars_width, big_mars_height, big_mars_bits);
    u8g2.sendBuffer();
    delay(1000);
  }
  delay(500);
}

void playPerseveranceSequence() {

  // buzz and flash sequence
  for (uint8_t i = 0; i < 3; i++) {
    analogWrite(BUZZER, HIGH);
    digitalWrite(LED, HIGH);
    drawShortText("ALERT", 45, 500);
    delay(250);
    analogWrite(BUZZER, LOW);
    digitalWrite(LED, LOW);
    drawShortText("ALERT", 45, 500);
    delay(250);
  }

  // landing animation
  while (ROVER_Y < 15) {
    u8g2.clearBuffer();
    u8g2.drawXBMP(ROVER_X, ROVER_Y, perseverance_width, perseverance_height, perseverance_bits);
    u8g2.sendBuffer();
    delay(350);
    ROVER_Y += 10;
  }
  ROVER_Y -= 10;
  delay(1500);
}

void drawPerseverance() {
  u8g2.drawXBMP(ROVER_X, ROVER_Y, perseverance_width, perseverance_height, perseverance_bits);
}

void showDirections() {
    drawShortText("USE THE JOYSTICK!", 5);
    drawLongText("HEAD WEST TO EX-", "PLORE THE MAR-", "TIAN LANDSCAPE.");
    drawLongText("HEAD EAST TO", "GO HOME - BACK", "TO EARTH.");
}

void exploreMars() {
//  drawShortText("MARS...", 40, 1000);
  u8g2.clearBuffer();
  u8g2.drawXBMP(0, 0, mars_landscape_2_width, mars_landscape_2_height, mars_landscape_2_bits);
  u8g2.sendBuffer();
  delay(3000);
//  drawLongText("MAYBE THERE'S", "LIFE OUT", "THERE...");
}

void tellLore() {
  // set up plotline
  drawLongText("ONCE UPON A", "TIME, ON PLANET", "MARS...");
  playMarsAnimation(); // show mars!
  drawLongText("...A MYSTERIOUS", "CREATURE FELL", "FROM THE SKY.");
  playPerseveranceSequence(); // perseverance landing
  drawLongText("YOU ARE THE", "PERSEVERANCE", "ROVER.");
  drawLongText("PRESS BUTTON TO", "VIEW CONTROLS");
}

void setup() {
  u8g2.begin();
  Serial.begin(9600);
  u8g2.setFont(u8g2_font_DigitalDisco_tu);
  pinMode(LED, OUTPUT);
  pinMode(BUZZER, OUTPUT);
  pinMode(BUTTON, INPUT);
  tellLore(); // display intro sequence
}


void loop() {

  int JOYSTICK = analogRead(A1); // joystick y-value (the x-value broke lmao)

  if (JOYSTICK < 460 && ROVER_X > -92) { // go leftwards
    ROVER_X -= 10; 
  }
  if (JOYSTICK > 560 && ROVER_X < 108) { // go rightwards
    ROVER_X += 10; 
  }

  if (ROVER_X == -92) { // head west
    digitalWrite(LED, HIGH);
    exploreMars();
    digitalWrite(LED, LOW);
    ROVER_X += 60;
  }

  if (ROVER_X == 108) { // head east
    digitalWrite(LED, HIGH);
//    exploreMars();
    digitalWrite(LED, LOW);
    ROVER_X -= 60;
  }

  if (digitalRead(BUTTON) == HIGH) {
    digitalWrite(LED, HIGH);
    showDirections();
    digitalWrite(LED, LOW);
  }

  // picture loop
  u8g2.firstPage();
  do {
    drawPerseverance();
  } while (u8g2.nextPage());

}
